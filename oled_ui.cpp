#include "OLED_UI.h"
#include "Config.h"
#include "gamepad.h"

const unsigned char epd_bitmap_pixil_frame_0_1_ [] PROGMEM = {
	0x00, 0x00, 0x00, 0x00, 0x00, 0x00, 0x00, 0x00, 0x00, 0x00, 0x00, 0x00, 0x00, 0x00, 0x00, 0x00, 
	0x00, 0x00, 0x00, 0x00, 0x00, 0x00, 0x00, 0x00, 0x00, 0x00, 0x00, 0x00, 0x00, 0x00, 0x00, 0x00, 
	0x00, 0x00, 0x00, 0x00, 0x00, 0x00, 0x00, 0x00, 0x00, 0x00, 0x00, 0x00, 0x00, 0x00, 0x00, 0x00, 
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	0x00, 0x00, 0x00, 0x00, 0x00, 0x00, 0x00, 0x00, 0x00, 0x00, 0x00, 0x00, 0x00, 0x00, 0x00, 0x00
};
const int epd_bitmap_allArray_LEN = 1;
const unsigned char* epd_bitmap_allArray[1] = {
  epd_bitmap_pixil_frame_0_1_
};


void drawProgressBar(int x, int y, int width, int height, int value, int maxValue) {
    int filled = map(value, 0, maxValue, 0, width);
    display.drawRect(x, y, width, height, SSD1306_WHITE);
    if (filled > 2){
        display.fillRect(x + 1, y + 1, filled - 2, height - 2, SSD1306_WHITE);
    }
}

void showSplashScreen() {
    display.clearDisplay();
    display.setTextSize(1);
    display.setTextColor(SSD1306_WHITE);

    int16_t x, y;
    uint16_t w, h;
    display.getTextBounds("Aguardando controle", 0, 0, &x, &y, &w, &h);
    display.setCursor((SCREEN_WIDTH - w) / 2, 2);
    display.println("Aguardando controle");

    display.drawBitmap(0, 16, epd_bitmap_pixil_frame_0_1_, SCREEN_WIDTH, 48, SSD1306_WHITE);
    display.display();
}

void showMainMenu() {
    display.clearDisplay();
    display.setTextSize(1);
    display.setTextColor(SSD1306_WHITE);

    int16_t x, z;
    uint16_t w, h;
    display.getTextBounds("Menu:", 0, 0, &x, &z, &w, &h);
    display.setCursor((SCREEN_WIDTH - w) / 2, 2);
    display.println("Menu:");

    for (int i = 0; i < menuItemCount; i++) {
        display.setCursor(10, 16 + i * 10);
        display.print(i == menuIndex ? "> " : "  ");
        display.print(menuItems[i]);
        if (i == 1) display.print(controllerModeActive ? " [X]" : " [ ]");
        display.println();
    }
    display.display();
}

void showLineFollowerMenu() {
    display.clearDisplay();
    display.setTextSize(1);
    display.setTextColor(SSD1306_WHITE);

    int16_t x, z;
    uint16_t w, h;
    display.getTextBounds("Seguidor de linha", 0, 0, &x, &z, &w, &h);
    display.setCursor((SCREEN_WIDTH - w) / 2, 2);
    display.println("Seguidor de linha");

    for (int i = 0; i < lfMenuItemCount; i++) {
        display.setCursor(10, 16 + i * 10);
        display.print(i == lfMenuIndex ? "> " : "  ");
        display.print(lfMenuItems[i]);

        char buf[10];
        if (i == 0) display.print(lineFollowerActive ? " [X]" : " [ ]");
        else if (i == 2) { dtostrf(Kp, 4, 2, buf); display.print(" : "); display.print(buf); }
        else if (i == 3) { dtostrf(Kd, 4, 2, buf); display.print(" : "); display.print(buf); }
        else if (i == 4) { display.print(" : "); display.print(threshold); }
        display.println();
    }
    display.display();
}

void showControllerInfo(ControllerPtr ctl) {
    display.clearDisplay();
    display.setTextSize(1);
    display.setTextColor(SSD1306_WHITE);

    int16_t x, z;
    uint16_t w, h;
    display.getTextBounds("Eixos e Gatilhos", 0, 0, &x, &z, &w, &h);
    display.setCursor((SCREEN_WIDTH - w) / 2, 2);
    display.println("Eixos e Gatilhos");

    int y = 14;
    const int lineHeight = 8;

    display.setCursor(0, y);
    display.print("LX:"); 
    drawProgressBar(24, y, 100, 6, ctl->axisX() + 512, 1023);
    y += lineHeight;

    display.setCursor(0, y);
    display.print("LY:");
    drawProgressBar(24, y, 100, 6, ctl->axisY() + 512, 1023);
    y += lineHeight;

    display.setCursor(0, y);
    display.print("RX:");
    drawProgressBar(24, y, 100, 6, ctl->axisRX() + 512, 1023);
    y += lineHeight;

    display.setCursor(0, y);
    display.print("RY:");
    drawProgressBar(24, y, 100, 6, ctl->axisRY() + 512, 1023);
    y += lineHeight;

    display.setCursor(0, y);
    display.print("LT:");
    drawProgressBar(24, y, 100, 6, ctl->brake(), 1023);
    y += lineHeight;

    display.setCursor(0, y);
    display.print("RT:");
    drawProgressBar(24, y, 100, 6, ctl->throttle(), 1023);

    display.display();
}

void showButtonsInfo(ControllerPtr ctl) {
    display.clearDisplay();
    display.setTextSize(1);
    display.setTextColor(SSD1306_WHITE);

    int16_t x, z;
    uint16_t w, h;
    
    display.getTextBounds("Botoes ativos:", 0, 0, &x, &z, &w, &h);
    display.setCursor((SCREEN_WIDTH - w) / 2, 2);
    display.println("Botoes ativos:");
    display.setCursor(0, 30);
    display.println(getPressedButtons(ctl));
    display.display();
}
